#include <LiquidCrystal_I2C.h>
#include <EEPROM.h>
#include <EtherCard.h>
#include <String.h>

#define CONTROL1PIN  2  // System-1 is controlled
#define CONTROL2PIN  3  // System-2 is controlled
#define CONTROL3PIN  4  // LCD on main controller is controlled

static byte mymac[] = { 0x74,0x69,0x69,0x2D,0x30,0x31 };  // Ethernet Module's MAC adress
byte Ethernet::buffer[700]; // Send and receive Buffer
boolean control1state;
boolean control2state;
boolean control3state= 0;

// Images of Buttons, which is used in website
static const unsigned char PROGMEM close[]= {
             0x89, 0x50, 0x4E, 0x47, 0x0D, 0x0A, 0x1A, 0x0A, 0x00, 0x00, 0x00, 0x0D, 0x49, 0x48, 0x44, 0x52, 0x00, 0x00, 0x00, 0x0E,
             0x00, 0x00, 0x00, 0x0E, 0x08, 0x04, 0x00, 0x00, 0x00, 0xB5, 0x41, 0xE5, 0x5A, 0x00, 0x00, 0x00, 0x01, 0x73, 0x52, 0x47,
             0x42, 0x00, 0xAE, 0xCE, 0x1C, 0xE9, 0x00, 0x00, 0x00, 0x02, 0x62, 0x4B, 0x47, 0x44, 0x00, 0xFF, 0x87, 0x8F, 0xCC, 0xBF,
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             0x44, 0xCC, 0x00, 0x00, 0x00, 0x00, 0x49, 0x45, 0x4E, 0x44, 0xAE, 0x42, 0x60, 0x82
             };
             
static const unsigned char PROGMEM open[]= {
             0x89, 0x50, 0x4E, 0x47, 0x0D, 0x0A, 0x1A, 0x0A, 0x00, 0x00, 0x00, 0x0D, 0x49, 0x48, 0x44, 0x52, 0x00, 0x00, 0x00, 0x0E,
             0x00, 0x00, 0x00, 0x0E, 0x04, 0x03, 0x00, 0x00, 0x00, 0xED, 0x66, 0x30, 0xE2, 0x00, 0x00, 0x00, 0x01, 0x73, 0x52, 0x47,
             0x42, 0x00, 0xAE, 0xCE, 0x1C, 0xE9, 0x00, 0x00, 0x00, 0x27, 0x50, 0x4C, 0x54, 0x45, 0x00, 0x00, 0x00, 0xFF, 0xCC, 0x00,
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             0x56, 0x0B, 0x58, 0x9D, 0x6A, 0x76, 0x99, 0x00, 0x00, 0x00, 0x00, 0x49, 0x45, 0x4E, 0x44, 0xAE, 0x42, 0x60, 0x82
             };
             

void send_png_image(const char* png_image, unsigned int image_size);
void onLCD();
void LCD_control();

LiquidCrystal_I2C lcd(0x27,16,2);


void setup () {
  
  Serial.begin(9600);
  lcd.begin();  // Initialization of LCD
  lcd.clear();

  if (ether.begin(sizeof Ethernet::buffer, mymac) == 0) // Initialization of Ethernet Module
    Serial.println( "Failed to access Ethernet module");
  ether.dhcpSetup(); // Assignment of IP adress to Module by DHCP
  static byte myip[] = { ether.myip[0],ether.myip[1],ether.myip[2],ether.myip[3] };
  ether.staticSetup(myip);  // The assigned IP is set as static IP.
  
  onLCD();  // IP of module is written on LCD.

  pinMode(CONTROL1PIN, OUTPUT);
  pinMode(CONTROL2PIN, OUTPUT);

  // The last system's states is received from EEPROM and assigned to digital pins.
  control1state = EEPROM.read(0);
  control2state = EEPROM.read(1);  
  digitalWrite(CONTROL1PIN, control1state);
  digitalWrite(CONTROL2PIN, control2state); 
}
  
void loop() {

  // Pocket knowledge is received continually.
  word len = ether.packetReceive();
  word pos = ether.packetLoop(len);

  if(pos) { 
    if(strstr((char *)Ethernet::buffer + pos, "GET /close.png") != 0) 
      send_png_image(close, sizeof(close));
    else if(strstr((char *)Ethernet::buffer + pos, "GET /open.png") != 0)
      send_png_image(open, sizeof(open));
    
    else {
      if(strstr((char *)Ethernet::buffer + pos, "GET /?CONTROL1") != 0) {
        control1state = !control1state;
        EEPROM.write(0,control1state);
        digitalWrite(CONTROL1PIN, control1state);  
      }
      
      if(strstr((char *)Ethernet::buffer + pos, "GET /?CONTROL2") != 0) {
        control2state = !control2state;
        EEPROM.write(1,control2state);
        digitalWrite(CONTROL2PIN, control2state);          
      }
      
       if(strstr((char *)Ethernet::buffer + pos, "GET /?CONTROL3") != 0) {
        control3state = !control3state;
        digitalWrite(CONTROL3PIN, control3state);
      }

      BufferFiller bfill = ether.tcpOffset();
      bfill.emit_p(PSTR("HTTP/1.0 200 OK\r\n"
        "Content-Type: text/html\r\nPragma: no-cache\r\n\r\n"
        "<html><head><title>Arduino Control Webserver</title></head><body>"
        "<div style=\"font-size:50px;background-color:LightGray;border:2px solid Gray;width:60%;margin:auto;text-align: center;\">System Control Application</div>"
        "<br>"
        ));
        
      if(!control1state) bfill.emit_p(PSTR("<div style=\"font-size:40px;\"> System-1: <a href=\"/?CONTROL1\"><img src=\"open.png\" width=\"30\" height=\"30\" ></a></div>"));
      else bfill.emit_p(PSTR("<div style=\"font-size:40px;\"> System-1: <a href=\"/?CONTROL1\"><img src=\"close.png\" width=\"30\" height=\"30\"></a><div>"));
     
      if(!control2state) bfill.emit_p(PSTR("<div style=\"font-size:40px;\"> System-2: <a href=\"/?CONTROL2\"><img src=\"open.png\" width=\"30\" height=\"30\"></a><div>"));
      else bfill.emit_p(PSTR("<div style=\"font-size:40px;\"> System-2: <a href=\"/?CONTROL2\"><img src=\"close.png\" width=\"30\" height=\"30\"></a><div>"));      

      if(!control3state)  bfill.emit_p(PSTR("<div style=\"font-size:40px;\"> LCD on Main: <a href=\"/?CONTROL3\"><img src=\"open.png\" width=\"30\" height=\"30\"></a><div>"));
      else  bfill.emit_p(PSTR("<div style=\"font-size:40px;\"> LCD on Main: <a href=\"/?CONTROL3\"><img src=\"close.png\" width=\"30\" height=\"30\"></a><div>"));  

      bfill.emit_p(PSTR("</body></html>"));
      ether.httpServerReply(bfill.position());
    } 
  }
  
  LCD_control();  // LCD's State is set according to control3state.
}

void send_png_image(const unsigned char* png_image, unsigned int image_size) {
  
  BufferFiller bfill = ether.tcpOffset();
  bfill.emit_p(PSTR("HTTP/1.0 200 OK\r\n"
    "Content-Type: image/png\r\n\r\n"));
  bfill.emit_raw_p((const char*)png_image, image_size);
  ether.httpServerReply(bfill.position());  
}

void onLCD(){
  
  lcd.setCursor(0,0);
  lcd.print("My IP:");
  lcd.setCursor(0,1);   lcd.print(ether.myip[0]);
  for(int i=1;i<4;i++){
    if(ether.myip[i-1]<10){
      lcd.setCursor(4*i-3,1);   lcd.print(".");
      lcd.setCursor((4*i-2),1); lcd.print(ether.myip[i]);
        
    }
    else if(ether.myip[i-1]<100&&ether.myip[i-1]>9){
      lcd.setCursor(4*i-2,1);   lcd.print(".");
      lcd.setCursor((4*i-1),1); lcd.print(ether.myip[i]);
    }
    else{
      lcd.setCursor(4*i-1,1);   lcd.print(".");
      lcd.setCursor(4*i,1);     lcd.print(ether.myip[i]);
    }
  }
}

void LCD_control(){

  if(!control3state){
    lcd.backlight();
    lcd.display();
  }  
  else{
    lcd.noBacklight();
    lcd.noDisplay();
  }
}
